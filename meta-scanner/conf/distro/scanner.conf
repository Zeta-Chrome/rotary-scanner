## meta-scanner/conf/distro/scanner.conf
```bitbake
# Inherit default baseline from Poky
require conf/distro/poky.conf

# Identity
DISTRO = "scanner"
DISTRO_NAME = "Scanner Distro"
DISTRO_VERSION = "1.0"
DISTRO_CODENAME = "stable"

# Enforce Systemd and remove legacy init
DISTRO_FEATURES:append = " systemd usrmerge"
DISTRO_FEATURES_BACKFILL_CONSIDERED:append = " sysvinit"
VIRTUAL-RUNTIME_init_manager = "systemd"
VIRTUAL-RUNTIME_initscripts = "systemd-compat-units"
```

## meta-scanner/conf/layer.conf
```bitbake
BBPATH .= ":${LAYERDIR}"
BBFILES += "${LAYERDIR}/recipes-*/*/*.bb \
            ${LAYERDIR}/recipes-*/*/*.bbappend"

BBFILE_COLLECTIONS += "meta-scanner"
BBFILE_PATTERN_meta-scanner = "^${LAYERDIR}/"
BBFILE_PRIORITY_meta-scanner = "6"

LAYERDEPENDS_meta-scanner = "core"
LAYERSERIES_COMPAT_meta-scanner = "scarthgap"
```

## meta-scanner/wic/scanner-usb.wks
```
part /boot --source bootimg-partition --ondisk sda --fstype=vfat --label boot --active --align 4096 --size 100 --fsoptions="defaults,nofail"
part / --source rootfs --ondisk sda --fstype=ext4 --label root --align 4096
```
