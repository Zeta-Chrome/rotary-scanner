/dts-v1/;
/plugin/;

/ {
	compatible = "brcm,bcm2835";

	fragment@0 {
		target = <&spi0>;
		__overlay__ {
			#address-cells = <1>;
			#size-cells = <0>;
			status = "okay";

			esp32cam@0 {
				compatible = "abel,esp32cam";
				reg = <0>;
				spi-max-frequency = <10000000>;
				interrupt-parent = <&gpio>;
				interrupts = <17 IRQ_TYPE_EDGE_RISING>;
			};
		};
	};

	fragment@1 {
		target = <&spidev0>;
		__overlay__ {
			status = "disabled";
		};
	};
};
